## drivers/adc/Kconfig.nrfx
```kconfig
config ADC_NRFX_ADC_INTERNAL
	bool "nRF ADC nrfx driver with internal support"
	default y
	depends on DT_HAS_NORDIC_NRF_ADC_ENABLED
	select NRFX_ADC
	select ADC_CONFIGURABLE_INPUTS
	help
	  Enable support for nrfx ADC driver for nRF51 MCU series with internal support.

config ADC_NRFX_ADC_CHANNEL_COUNT
	int "Number of ADC channels"
	depends on ADC_NRFX_ADC_INTERNAL
	range 1 8
	default 1
	help
	  Number of ADC channels to be supported by the driver. Each channel
	  needs a dedicated structure in RAM that stores the ADC settings
	  to be used when sampling this channel.
```

## drivers/sensor/aosong/dht/Kconfig
```kconfig
# DHT Temperature and Humidity Sensor configuration options

# Copyright (c) 2016 Intel Corporation
# Copyright (c) 2024 Jamie M.
# SPDX-License-Identifier: Apache-2.0

menuconfig DHT_TIMER
	bool "DHT Temperature and Humidity Sensor using timer"
	default y
	depends on DT_HAS_AOSONG_DHT_ENABLED
	depends on GPIO
	depends on SOC_SERIES_NRF51X
	depends on COUNTER_NRF_TIMER
	depends on !DHT
	help
	  Enable driver for the DHT temperature and humidity sensor family.
	  Uses timer1 for timing

if DHT_TIMER

config DHT_TIMER_LOCK_IRQS
	bool "Lock IRQs for sensor measurement"
	help
	  Locks IRQs when taking sensor readings, this greatly improves the chances of getting a
	  reading successfully from the sensor at the cost of delayed interrupt servicing (e.g.
	  Bluetooth). Note that other systems might need to be adjusted to account for this.

endif # DHT_TIMER
```

## subsys/mgmt/mcumgr/transport/Kconfig
```kconfig
#
# Copyright (c) 2024, Jamie M.
#
# All right reserved. This code is NOT apache or FOSS/copyleft licensed.
#

config MCUMGR_TRANSPORT_NETBUF_COUNT
	default 2 if MCUMGR_TRANSPORT_LORA

config MCUMGR_TRANSPORT_NETBUF_SIZE
	default 222 if MCUMGR_TRANSPORT_LORA

config MCUMGR_TRANSPORT_NETBUF_MIN_USER_DATA_SIZE
	default 0 if MCUMGR_TRANSPORT_LORA && !MCUMGR_TRANSPORT_BT

rsource "Kconfig.lora"
```

## subsys/mgmt/mcumgr/transport/Kconfig.lora
```kconfig
#
# Copyright (c) 2024, Jamie M.
#
# All right reserved. This code is NOT apache or FOSS/copyleft licensed.
#

# The Kconfig file is dedicated to the LoRa transport of MCUmgr
# subsystem and provides Kconfig options to control aspects of
# the transport.
#
# Options defined in this file should be prefixed:
#  MCUMGR_TRANSPORT_LORA_

menuconfig MCUMGR_TRANSPORT_LORA
	bool "LoRa MCUmgr SMP transport"
	help
	  Enables handling of SMP commands received over LoRa.

if MCUMGR_TRANSPORT_LORA

config MCUMGR_TRANSPORT_LORA_PORT
	int "LoRa SMP port"
	range 0 120
	default 2
	help
	  LoRa download and uplink for communication. All messages received on this port will be
	  treated as SMP packets.

config MCUMGR_TRANSPORT_LORA_CONFIRMED_PACKETS
	bool "Use confirmed packets for uplinks"
	default y
	help
	  Will use confirmed uplink packets for responses if enabled, otherwise will use
	  unconfirmed packets.

config MCUMGR_TRANSPORT_LORA_REASSEMBLY
	bool "Reassemble LoRa SMP messages"
	select MCUMGR_TRANSPORT_REASSEMBLY
	default y
	help
	  Will reassemble downlink LoRa messages together to allow for messages larger than a
	  single message to be recieved, otherwise will support messages up to a single packet in
	  size.

config MCUMGR_TRANSPORT_LORA_POLL_FOR_DATA
	bool "Send empty packet if partial packet received"
	depends on MCUMGR_TRANSPORT_LORA_REASSEMBLY
	default y
	help
	  Will send an empty packet if a partial (fragmented) message has been recieved from the
	  server, this will allow the next packet to be recieved without waiting for next
	  transmission window.

config MCUMGR_TRANSPORT_LORA_FRAGMENTED_UPLINKS
	bool "Fragment uplink messages"
	default y
	help
	  Will fragment messages into multiple uplink messages if they are too big to fit into a
	  single uplink message. If disabled then uplinks that are too large will not be sent.

module = MCUMGR_TRANSPORT_LORA
module-str = LoRa MCUmgr SMP transport
source "subsys/logging/Kconfig.template.log_config"

endif # MCUMGR_TRANSPORT_LORA
```
