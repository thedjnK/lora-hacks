## west.yml
```yaml
manifest:
  remotes:
    - name: zephyr
      url-base: https://github.com/zephyrproject-rtos
    - name: thedjnK
      url-base: https://github.com/thedjnK

  projects:
    - name: zephyr
      remote: thedjnK
      revision: nrf51btbranch
      import:
        name-allowlist:
          - cmsis
          - hal_nordic
          - mcuboot
          - picolibc
          - tinycrypt
          - zcbor
    - name: boards
      remote: thedjnK
      revision: main
    - name: loramac-node
      path: modules/lib/loramac-node/
      remote: thedjnK
      revision: lora-hacks-ng

  self:
    path: lora-hacks
```
